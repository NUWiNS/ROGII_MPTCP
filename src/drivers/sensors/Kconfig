## src/drivers/sensors/Kconfig
```kconfig
config SENSORS_SSC
	bool "Enable Sensors Driver Support for SSC"
	help
	  Add support for sensors SSC driver.
	  This driver is used for exercising sensors use case,
	  time syncing with ADSP clock.
config GOODIXFP_SPIDRV
	tristate "FingerPrint sensor"
	depends on SPI_MASTER
	help
	  add for support FP Sensor.
```
